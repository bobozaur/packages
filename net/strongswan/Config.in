## net/strongswan/Config.in
```kconfig
if PACKAGE_strongswan
comment "Configuration"

# --with-routing-table
config STRONGSWAN_ROUTING_TABLE
	string
	prompt "Set the IPsec routing table ID"
	default "220"

#  --with-routing-table-prio
config STRONGSWAN_ROUTING_TABLE_PRIO
	string
	prompt "Set the IPsec routing table priority"
	default "220"

config STRONGSWAN_IKEV1
	bool "Enable IKEv1 compatibility"
	default y
	help
	  Keep IKEv1 support available for existing configurations.
	  Disable this option for installations using IKEv2 exclusively.

config STRONGSWAN_INCLUDE_INSECURE
	bool
	prompt "Include cryptographically weak protocols"
	default !PACKAGE_libopenssl

comment "Packages"

endif
```
